/*
 * Copyright (c) 2019-2021, Arm Limited. All rights reserved.
 *
 * SPDX-License-Identifier: BSD-3-Clause
 *
 * This file is a Partition Manifest (PM) for a minimal Secure Partition (SP)
 * that has additional optional properties defined.
 *
 */

/dts-v1/;

/ {
	compatible = "arm,ffa-manifest-1.0";
	debug_name = "partition-manifest";

	/* Properties */
	ffa-version = <0x00010000>; /* 31:16 - Major, 15:0 - Minor */
	uuid = <0x2e67b5b4 0xe14f904a 0x13fb1fb8 0xcbdae1da>;
	execution-ctx-count = <1>;
	exception-level = <1>; /* S-EL0 */
	execution-state = <0>; /* AARCH64 */
	load-address = <0x7800000>;
	entrypoint-offset = <0x1000>;
	xlat-granule = <0>; /* 4KiB */
	messaging-method = <3>; /* Direct messaging only */
	boot-order = <0>;
};